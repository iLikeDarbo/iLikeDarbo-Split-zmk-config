## boards/shields/Kconfig.shield
```kconfig
config SHIELD_ILIKEDARBO_SPLIT_LEFT
    def_bool $(shields_list_contains,ilikedarbo_split_left)

config SHIELD_ILIKEDARBO_SPLIT_RIGHT
    def_bool $(shields_list_contains,ilikedarbo_split_right)
```

## boards/shields/ild_split/Kconfig.defconfig
```kconfig
if SHIELD_ILD_SPLIT_LEFT

config ZMK_KEYBOARD_NAME
    default "ild_split"

config ZMK_SPLIT_ROLE_CENTRAL
    default y

endif # SHIELD_ILIKEDARBO_SPLIT_LEFT

if SHIELD_ILD_SPLIT_LEFT || SHIELD_ILD_SPLIT_RIGHT

config ZMK_SPLIT
    default y

endif # SHIELD_ILIKEDARBO_SPLIT_LEFT || SHIELD_ILIKEDARBO_SPLIT_RIGHT
```

## boards/shields/ild_split/Kconfig.shield
```kconfig
config SHIELD_ILD_SPLIT_LEFT
    def_bool $(shields_list_contains,ild_split_left)

config SHIELD_ILD_SPLIT_RIGHT
    def_bool $(shields_list_contains,ild_split_right)
```

## boards/shields/ilikedarbo_split/Kconfig.defconfig
```kconfig
if SHIELD_ILIKEDARBO_SPLIT_LEFT

config ZMK_KEYBOARD_NAME
    default "iLikeDarbo_split"

config ZMK_SPLIT_ROLE_CENTRAL
    default y

endif # SHIELD_ILIKEDARBO_SPLIT_LEFT

if SHIELD_ILIKEDARBO_SPLIT_LEFT || SHIELD_ILIKEDARBO_SPLIT_RIGHT

config ZMK_SPLIT
    default y

endif # SHIELD_ILIKEDARBO_SPLIT_LEFT || SHIELD_ILIKEDARBO_SPLIT_RIGHT
```
